int x[7]={1,2,3,4,5,6,7};
int z[10][7]={{1,1,1,1,1,1,0}
              ,{0,1,1,0,0,0,0}
              ,{1,1,0,1,1,0,1}
              ,{1,1,1,1,0,0,1}
              ,{0,1,1,0,0,1,1}
              ,{1,0,1,1,0,1,1}
              ,{1,0,1,1,1,1,1}
              ,{1,1,1,0,0,0,0}
              ,{1,1,1,1,1,1,1}
              ,{1,1,1,1,0,1,1}};
void setup()
{for(int i=0;i<=6;i++)
{pinMode(x[i],OUTPUT);}
 }

void loop()
{
  for(int i=0;i<=9;i++)
  {for(int y=0;y<=6;y++)
  {digitalWrite(x[y],z[i][y]);}
   delay(1000);}

   for(int i=9;i>=0;i--)
  {for(int y=6;y>=0;y--)
  {digitalWrite(x[y],z[i][y]);}
   delay(1000);}
  
}
